## platform/device/amazon/kernel/driver/dspframework/Kconfig
```kconfig
menu "Amazon dsp framework driver common"

config AMZN_DSP_FRAMEWORK
	tristate "adf support"
	default n
	help
		support adf;

config AMZN_DSP_FRAMEWORK_CHAR_LEN
	int "dsp char bit length"
	default 1
	help
		dsp char bit length;

endmenu
```
